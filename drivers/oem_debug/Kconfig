## drivers/oem_debug/Kconfig
```kconfig
config OEM_FORCE_DUMP
        depends on CONFIG_QCOM_DLOAD_MODE
	default y
	bool "OEM force dump function, it will enable goto the force dump"
```

## drivers/oneplus/Kconfig
```kconfig
config OEM_DEBUG_SUPPORT
        bool "OEM debug support"
        default n

config OEM_TRACE_SUPPORT
	depends on OEM_DEBUG_SUPPORT
	bool "OEM debug function, enable it will register the device, which under /dev/otracer."
	default y
```
